## CMakeLists.txt
```
cmake_minimum_required(VERSION 3.20.0)

find_package(Zephyr REQUIRED HINTS $ENV{ZEPHYR_BASE})
PROJECT(fake_sensor_node)

# include MAVLink headers
target_include_directories(app PRIVATE
    c_library_v2/
)

target_sources(app PRIVATE 
src/main.c
src/uartLayer.c
src/mavlinkLayer.c
)
```

## prj.conf
```kconfig
#enabele uart
CONFIG_SERIAL=y
CONFIG_UART_INTERRUPT_DRIVEN=y

#disable debug console
CONFIG_PRINTK=n
CONFIG_STDOUT_CONSOLE=n
```

## src/main.c
```c
/**
 * @mainpage mavlink-distance-node
 *
 * @section intro Introduction
 * A portable MAVLink v2 fake distance sensor node implemented on Zephyr RTOS.
 * Simulates four directional distance sensors (front, right, back, left) and
 * transmits readings to a flight controller over UART using standard MAVLink
 * DISTANCE_SENSOR messages.
 *
 * Designed to be platform-agnostic — any board supported by Zephyr with a
 * UART peripheral can run this node without hardware modification.
 *
 * @section arch Software Architecture
 * The project is structured in three independent layers:
 *
 * - Application Layer (main.c) — scheduling, sensor simulation, work items
 * - MAVLink Layer (mavlinkLayer.c) — message packing and serialisation
 * - UART Layer (uartLayer.c) — transmission, message queue, TX thread
 *
 * @section scheduling Scheduling
 * Zephyr delayable work items replace dedicated threads for the application
 * logic. Both heartbeat and distance work items run on the system workqueue
 * and reschedule themselves after each execution. No mutex is required because
 * the system workqueue is single-threaded by default.
 *
 * A dedicated UART TX thread inside the UART layer drains the message queue
 * and transmits packets independently of the application work items.
 *
 * @section portability Portability
 * No hardware-specific register access is used anywhere in the application or
 * MAVLink layers. The UART layer uses the Zephyr UART driver API exclusively.
 * To port to a different board, update the board overlay and prj.conf only.
 *
 * @section msgs MAVLink Messages
 * | Message            | Rate  | Description                        |
 * |--------------------|-------|------------------------------------|
 * | HEARTBEAT          | 1 Hz  | Node identification to FC          |
 * | DISTANCE_SENSOR x4 | 10 Hz | Front, right, back, left readings  |
 *
 * @section author Author
 * W S G De Silva
 * M.Sc. Embedded Systems, Technische Universitat Chemnitz
 *
 * @section date Date
 * 2026
 */

/**
 * @file    main.c
 * @brief   Application layer — sensor simulation and work item scheduling
 *
 * Implements the top-level application logic for the mavlink-distance-node.
 * Defines the distanceSensor_t structure, initialises four sensor instances
 * with independent speeds, and schedules MAVLink transmissions using Zephyr
 * delayable work items.
 *
 * No UART or MAVLink protocol details are present in this layer.
 */

#include <stdint.h>
#include <zephyr/kernel.h>
#include <zephyr/device.h>
#include <zephyr/drivers/uart.h>
#include <zephyr/random/random.h>

#include <stdio.h>
#include <string.h>

#include "uartLayer.h"
#include "mavlinkLayer.h"

/** @brief Minimum valid sensor distance in centimetres */
#define MIN_DIST_CM 50U

/** @brief Maximum valid sensor distance in centimetres */
#define MAX_DIST_CM 200U

/** @brief Zephyr delayable work item for HEARTBEAT transmission */
static struct k_work_delayable heartbeat_dwork;

/** @brief Zephyr delayable work item for DISTANCE_SENSOR transmission */
static struct k_work_delayable distance_dwork;

/**
 * @brief Simulated distance sensor state
 *
 * Tracks the current distance value and triangle wave oscillation state
 * for one simulated sensor. Each sensor instance has an independent speed
 * producing visibly different oscillation rates on the flight controller.
 */
typedef struct {
    uint8_t  id;        /**< Sensor instance identifier 0-3 */
    int16_t  distance;  /**< Current distance value in centimetres */
    uint16_t speed;     /**< Step size in centimetres per update cycle */
    int16_t  direction; /**< Oscillation direction: +1 increment, -1 decrement */
} distanceSensor_t;

/**
 * @brief Sensor array — four directional sensors with independent speeds
 *
 * Sensor 0: front,  starts at 50 cm,  speed 2 cm/cycle  — slow
 * Sensor 1: right,  starts at 80 cm,  speed 5 cm/cycle  — medium
 * Sensor 2: back,   starts at 120 cm, speed 8 cm/cycle  — fast
 * Sensor 3: left,   starts at 160 cm, speed 3 cm/cycle  — medium slow
 */
distanceSensor_t sensorArr[4] = {
    {0, 50,  2, 1},
    {1, 80,  5, 1},
    {2, 120, 8, 1},
    {3, 160, 3, 1},
};

/**
 * @brief Update sensor state and return current distance value
 *
 * Advances the sensor triangle wave by one step. When the value reaches
 * MAX_DIST_CM the direction reverses to decrement. When it reaches
 * MIN_DIST_CM the direction reverses to increment.
 *
 * @param sensor  Pointer to sensor state to update
 * @return        Current distance value in centimetres after update
 *
 * @note Called once per 100ms cycle per sensor from distance_handler
 */
uint16_t fake_distance(distanceSensor_t *sensor) {
    sensor->distance += (sensor->direction * sensor->speed);
    if (sensor->distance >= MAX_DIST_CM) {
        sensor->distance = MAX_DIST_CM;
        sensor->direction = -1;
        return sensor->distance;
    }
    if (sensor->distance <= MIN_DIST_CM) {
        sensor->distance = MIN_DIST_CM;
        sensor->direction = 1;
        return sensor->distance;
    }
    return sensor->distance;
}

/**
 * @brief Zephyr work handler — transmit HEARTBEAT and reschedule
 *
 * Called by the system workqueue every 1000ms. Sends one MAVLink
 * HEARTBEAT message then reschedules itself for the next cycle.
 *
 * @param work  Pointer to the work item (unused, required by Zephyr API)
 */
static void heartbeat_handler(struct k_work *work) {
    send_heart_beat();
    k_work_schedule(&heartbeat_dwork, K_MSEC(1000));
}

/**
 * @brief Zephyr work handler — transmit all four sensor readings and reschedule
 *
 * Called by the system workqueue every 100ms. Updates all four sensor
 * simulation states, then sends four MAVLink DISTANCE_SENSOR messages.
 * Reschedules itself for the next cycle.
 *
 * @param work  Pointer to the work item (unused, required by Zephyr API)
 */
static void distance_handler(struct k_work *work) {
    send_all_distance_data(
        fake_distance(&sensorArr[0]),
        fake_distance(&sensorArr[1]),
        fake_distance(&sensorArr[2]),
        fake_distance(&sensorArr[3])
    );
    k_work_schedule(&distance_dwork, K_MSEC(100));
}

/**
 * @brief Application entry point
 *
 * Initialises the UART layer, registers both delayable work items,
 * and schedules the first execution of each. Returns immediately after
 * scheduling — Zephyr kernel takes over from this point.
 *
 * @return 0 on success
 */
int main(void) {
    uart_init();

    k_work_init_delayable(&heartbeat_dwork, heartbeat_handler);
    k_work_init_delayable(&distance_dwork,  distance_handler);

    k_work_schedule(&heartbeat_dwork, K_MSEC(1000));
    k_work_schedule(&distance_dwork,  K_MSEC(100));

    return 0;
}
```

## src/mavlinkLayer.c
```c
/**
 * @file    mavlinkLayer.c
 * @brief   MAVLink v2 message packing and transmission implementation
 *
 * Implements HEARTBEAT and DISTANCE_SENSOR message generation using the
 * MAVLink c_library_v2 header-only library. Each function packs a message
 * into a uart_packet_t buffer and passes it to the UART layer queue via
 * uart_queue_up(). This layer has no knowledge of UART registers, Zephyr
 * driver internals, or queue implementation details.
 *
 * Uses k_uptime_get_32() for the MAVLink time_boot_ms timestamp field,
 * providing millisecond resolution uptime sourced from the Zephyr kernel.
 */

#include "mavlinkLayer.h"
#include "common/mavlink.h"
#include "zephyr/kernel.h"
#include "uartLayer.h"

void send_heart_beat(void) {
    mavlink_message_t msg;
    uart_packet_t hearBeatPacket;

    mavlink_msg_heartbeat_pack(
        SYS_ID, COMP_ID, &msg,
        MAV_TYPE_GENERIC,
        MAV_AUTOPILOT_INVALID,
        0, 0,
        MAV_STATE_ACTIVE
    );

    uint16_t len = mavlink_msg_to_send_buffer(hearBeatPacket.buf, &msg);
    hearBeatPacket.len = len;
    uart_queue_up(&hearBeatPacket);
}

/**
 * @brief Pack and queue a single DISTANCE_SENSOR message
 *
 * Internal helper called four times by send_all_distance_data() with
 * different sensor IDs, orientations, and distance values. Packs a
 * complete MAVLink DISTANCE_SENSOR frame and queues it for transmission.
 *
 * The quaternion field is set to identity [1, 0, 0, 0] indicating no
 * additional mounting angle correction beyond the orientation enum value.
 * Covariance is set to 255 indicating unknown measurement uncertainty.
 * Signal quality is set to 0 indicating unknown.
 *
 * @param id           Sensor instance number 0-3
 * @param orientation  MAV_SENSOR_ROTATION_* enum value for this sensor
 * @param distance     Current distance reading in centimetres
 */
static void send_fake_distance(uint8_t id, uint8_t orientation, uint16_t distance) {
    float q[4] = {1.0f, 0.0f, 0.0f, 0.0f};
    mavlink_message_t msg;
    uart_packet_t distancePacket;

    mavlink_msg_distance_sensor_pack(
        SYS_ID,
        COMP_ID,
        &msg,
        k_uptime_get_32(),              /**< Milliseconds since boot — Zephyr kernel time */
        MIN_SENSOR_RANGE,               /**< Sensor minimum range in centimetres */
        MAX_SENSOR_RANGE,               /**< Sensor maximum range in centimetres */
        distance,                       /**< Current simulated distance in centimetres */
        MAV_DISTANCE_SENSOR_LASER,      /**< Sensor type — laser rangefinder */
        id,                             /**< Sensor instance identifier */
        orientation,                    /**< MAV_SENSOR_ROTATION_* mounting direction */
        255,                            /**< Covariance — 255 = unknown */
        0.0f,                           /**< Horizontal FOV — 0 = unknown */
        0.0f,                           /**< Vertical FOV — 0 = unknown */
        q,                              /**< Quaternion — identity, no additional rotation */
        0                               /**< Signal quality — 0 = unknown */
    );

    uint16_t len = mavlink_msg_to_send_buffer(distancePacket.buf, &msg);
    distancePacket.len = len;
    uart_queue_up(&distancePacket);
}

void send_all_distance_data(uint16_t frontSensorValue,
                             uint16_t rightSensorValue,
                             uint16_t backSensorValue,
                             uint16_t leftSensorValue) {
    send_fake_distance(0, MAV_SENSOR_ROTATION_NONE,    frontSensorValue);
    send_fake_distance(1, MAV_SENSOR_ROTATION_YAW_90,  rightSensorValue);
    send_fake_distance(2, MAV_SENSOR_ROTATION_YAW_180, backSensorValue);
    send_fake_distance(3, MAV_SENSOR_ROTATION_YAW_270, leftSensorValue);
}
```

## src/mavlinkLayer.h
```c
/**
 * @file    mavlinkLayer.h
 * @brief   MAVLink v2 message layer for mavlink-distance-node
 *
 * Provides the public interface for MAVLink message packing and transmission.
 * This layer has no knowledge of UART hardware, Zephyr scheduling, or
 * message queue internals. It depends only on the UART layer's
 * uart_queue_up() function for byte delivery.
 *
 * Defines the uart_packet_t structure used as the inter-layer
 * data transfer type between MAVLink and UART layers.
 *
 * @note All MAVLink packing uses c_library_v2 header-only library.
 *       No dynamic memory allocation is performed anywhere in this layer.
 */

#ifndef MAVLINKLAYER_H
#define MAVLINKLAYER_H

#include <stdint.h>
#include "common/mavlink.h"

/** @brief MAVLink system ID — unique node identifier on the MAVLink network */
#define SYS_ID           1U

/** @brief MAVLink component ID — identifies node as obstacle avoidance sensor */
#define COMP_ID          MAV_COMP_ID_OBSTACLE_AVOIDANCE

/** @brief Minimum valid sensor range in centimetres */
#define MIN_SENSOR_RANGE 50U

/** @brief Maximum valid sensor range in centimetres */
#define MAX_SENSOR_RANGE 200U

/**
 * @brief Serialised MAVLink packet ready for UART transmission
 *
 * Produced by mavlink_msg_to_send_buffer() and passed to the UART
 * layer via uart_queue_up(). The buf field contains a complete
 * MAVLink v2 frame including header, payload, and CRC.
 */
typedef struct {
    uint8_t  buf[MAVLINK_MAX_PACKET_LEN]; /**< Serialised MAVLink frame bytes */
    uint16_t len;                          /**< Number of valid bytes in buf */
} uart_packet_t;

/**
 * @brief Pack and queue a MAVLink HEARTBEAT message
 *
 * Packs a HEARTBEAT identifying this node as MAV_TYPE_GENERIC with
 * MAV_AUTOPILOT_INVALID and MAV_STATE_ACTIVE. Serialises to a
 * uart_packet_t and passes to the UART layer queue.
 *
 * Must be called at 1 Hz or the flight controller will mark this
 * component as timed out and stop processing its sensor messages.
 */
void send_heart_beat(void);

/**
 * @brief Pack and queue all four directional DISTANCE_SENSOR messages
 *
 * Sends four MAVLink DISTANCE_SENSOR messages in sequence covering
 * front, right, back, and left directions. Each message carries an
 * independent distance value and the correct MAV_SENSOR_ROTATION
 * orientation for that direction.
 *
 * Sensor orientation mapping:
 * - Sensor 0: front  MAV_SENSOR_ROTATION_NONE
 * - Sensor 1: right  MAV_SENSOR_ROTATION_YAW_90
 * - Sensor 2: back   MAV_SENSOR_ROTATION_YAW_180
 * - Sensor 3: left   MAV_SENSOR_ROTATION_YAW_270
 *
 * @param frontSensorValue  Forward distance reading in centimetres
 * @param rightSensorValue  Right distance reading in centimetres
 * @param backSensorValue   Rear distance reading in centimetres
 * @param leftSensorValue   Left distance reading in centimetres
 *
 * @note All values must be between MIN_SENSOR_RANGE and MAX_SENSOR_RANGE
 *       or the flight controller may reject the reading
 */
void send_all_distance_data(uint16_t frontSensorValue,
                             uint16_t rightSensorValue,
                             uint16_t backSensorValue,
                             uint16_t leftSensorValue);

#endif
```

## src/uartLayer.c
```c
/**
 * @file    uartLayer.c
 * @brief   UART transmission layer implementation
 *
 * Implements UART initialisation, message queuing, and byte transmission
 * for the mavlink-distance-node. Owns a Zephyr message queue and a
 * dedicated TX thread that drains the queue independently of the
 * application and MAVLink layers.
 *
 * The message queue and TX thread are private to this file. External
 * callers interact only via uart_init() and uart_queue_up().
 *
 * No mutex is required because the system workqueue that drives the
 * MAVLink layer is single-threaded by default in Zephyr. The queue
 * itself is thread-safe by design.
 *
 * Platform portability: no register-level access is used. All hardware
 * interaction goes through the Zephyr UART driver API. To port to a
 * different board update the device tree node label and board overlay.
 */

#include "uartLayer.h"
#include "mavlinkLayer.h"
#include <zephyr/drivers/uart.h>
#include <zephyr/device.h>
#include <zephyr/kernel.h>
#include <string.h>

/** @brief Zephyr UART device handle — resolved at compile time from device tree */
const struct device *uart2 = DEVICE_DT_GET(DT_NODELABEL(usart2));

/**
 * @brief Internal UART transmit message queue
 *
 * Holds serialised MAVLink packets pending transmission. Depth of 100
 * packets provides sufficient headroom for normal 1Hz and 10Hz operation
 * with no packet loss under any scheduling condition.
 *
 * Private to this translation unit — not accessible from other layers.
 */
K_MSGQ_DEFINE(uart_msgq, sizeof(uart_packet_t), 100, 4);

int uart_init(void) {
    struct uart_config uart_cfg = {
        .baudrate  = 57600,
        .parity    = UART_CFG_PARITY_NONE,
        .stop_bits = UART_CFG_STOP_BITS_1,
        .flow_ctrl = UART_CFG_FLOW_CTRL_NONE,
        .data_bits = UART_CFG_DATA_BITS_8,
    };

    int ret = uart_configure(uart2, &uart_cfg);
    return ret;
}

int uart_send(uart_packet_t uartPkt) {
    for (int i = 0; i < uartPkt.len; i++) {
        uart_poll_out(uart2, uartPkt.buf[i]);
    }
    return 0;
}

int uart_queue_up(uart_packet_t *uartPkt) {
    return k_msgq_put(&uart_msgq, uartPkt, K_NO_WAIT);
}

/**
 * @brief Internal UART TX thread function
 *
 * Blocks on the internal message queue indefinitely. When a packet arrives
 * it is dequeued and transmitted byte by byte via uart_send(). Runs at
 * priority 3 — higher than the system workqueue default — to ensure
 * packets are drained promptly without queue overflow.
 *
 * This function is private to the UART layer. It is not declared in the
 * header and is not callable from other layers.
 *
 * @param a  Unused thread argument
 * @param b  Unused thread argument
 * @param c  Unused thread argument
 */
static void uart_tx_thread(void *a, void *b, void *c) {
    while (1) {
        uart_packet_t pkt;
        k_msgq_get(&uart_msgq, &pkt, K_FOREVER);
        uart_send(pkt);
    }
}

/** @brief Static TX thread definition — started automatically by Zephyr kernel */
K_THREAD_DEFINE(uart_tx_tid, 2048, uart_tx_thread, NULL, NULL, NULL, 3, 0, 0);
```

## src/uartLayer.h
```c
/**
 * @file    uartLayer.h
 * @brief   UART transmission layer for mavlink-distance-node
 *
 * Provides the public interface for UART initialisation and packet queuing.
 * Internally owns a Zephyr message queue and a dedicated TX thread that
 * drains the queue and transmits bytes via uart_poll_out(). These
 * implementation details are private to uartLayer.c and not exposed here.
 *
 * This layer uses the Zephyr UART driver API exclusively — no register
 * level hardware access. Compatible with any board supported by Zephyr
 * that exposes a usart2 device tree node.
 *
 * @note uart_packet_t is defined in mavlinkLayer.h and shared between
 *       the MAVLink and UART layers as the inter-layer data transfer type.
 */

#ifndef UARTLAYER_H
#define UARTLAYER_H

#include <stdint.h>
#include "mavlinkLayer.h"
#include <zephyr/kernel.h>

/**
 * @brief Initialise UART2 with MAVLink communication settings
 *
 * Configures UART2 via the Zephyr UART driver API:
 * - Baud rate: 57600
 * - Data bits: 8
 * - Parity: none
 * - Stop bits: 1
 * - Flow control: none
 *
 * Must be called once before any call to uart_queue_up().
 *
 * @return 0 on success, negative errno on failure
 */
int uart_init(void);

/**
 * @brief Queue a serialised MAVLink packet for UART transmission
 *
 * Copies the packet into the internal message queue. The internal TX thread
 * drains the queue and transmits bytes asynchronously. This function returns
 * immediately without blocking the caller.
 *
 * If the queue is full the packet is dropped. Queue depth is 100 packets
 * which is sufficient for normal 1Hz heartbeat and 10Hz sensor operation.
 *
 * @param uartPkt  Pointer to uart_packet_t containing serialised MAVLink frame
 * @return         0 on success, negative value if queue put failed
 *
 * @note This is the only UART layer function called by the MAVLink layer
 */
int uart_queue_up(uart_packet_t *uartPkt);

/**
 * @brief Transmit a serialised MAVLink packet over UART2
 *
 * Blocking byte-by-byte transmission using uart_poll_out(). Called
 * internally by the UART TX thread — not intended for direct use by
 * other layers.
 *
 * @param uartPkt  uart_packet_t containing bytes and length to transmit
 * @return         0 on success
 */
int uart_send(uart_packet_t uartPkt);

#endif
```
